## nerves_defconfig
```kconfig
BR2_x86_64=y
BR2_TOOLCHAIN_EXTERNAL=y
BR2_TOOLCHAIN_EXTERNAL_CUSTOM=y
BR2_TOOLCHAIN_EXTERNAL_DOWNLOAD=y
BR2_TOOLCHAIN_EXTERNAL_URL="https://github.com/nerves-project/toolchains/releases/download/v13.2.0/nerves_toolchain_x86_64_nerves_linux_musl-linux_${shell uname -m}-13.2.0-8123CAA.tar.xz"
BR2_TOOLCHAIN_EXTERNAL_CUSTOM_PREFIX="$(ARCH)-nerves-linux-musl"
BR2_TOOLCHAIN_EXTERNAL_GCC_13=y
BR2_TOOLCHAIN_EXTERNAL_HEADERS_5_4=y
BR2_TOOLCHAIN_EXTERNAL_CUSTOM_MUSL=y
BR2_TOOLCHAIN_EXTERNAL_CXX=y
BR2_TOOLCHAIN_EXTERNAL_FORTRAN=y
BR2_TOOLCHAIN_EXTERNAL_OPENMP=y
BR2_TAR_OPTIONS="--no-same-owner"
BR2_BACKUP_SITE="https://dl.nerves-project.org"
BR2_ENABLE_DEBUG=y
BR2_GLOBAL_PATCH_DIR="${BR2_EXTERNAL_NERVES_PATH}/patches"
BR2_REPRODUCIBLE=y
BR2_ROOTFS_SKELETON_CUSTOM=y
BR2_ROOTFS_SKELETON_CUSTOM_PATH="${BR2_EXTERNAL_NERVES_PATH}/board/nerves-common/skeleton"
BR2_INIT_NONE=y
BR2_ENABLE_LOCALE_WHITELIST="locale-archive"
BR2_ROOTFS_OVERLAY="${BR2_EXTERNAL_NERVES_PATH}/board/nerves-common/rootfs_overlay ${NERVES_DEFCONFIG_DIR}/rootfs_overlay"
BR2_ROOTFS_POST_BUILD_SCRIPT="${NERVES_DEFCONFIG_DIR}/post-build.sh ${BR2_EXTERNAL_NERVES_PATH}/board/nerves-common/post-build.sh"
BR2_ROOTFS_POST_IMAGE_SCRIPT="${NERVES_DEFCONFIG_DIR}/post-createfs.sh"
BR2_LINUX_KERNEL=y
BR2_LINUX_KERNEL_CUSTOM_VERSION=y
BR2_LINUX_KERNEL_CUSTOM_VERSION_VALUE="6.12.54"
BR2_LINUX_KERNEL_USE_CUSTOM_CONFIG=y
BR2_LINUX_KERNEL_CUSTOM_CONFIG_FILE="${NERVES_DEFCONFIG_DIR}/linux-6.12.defconfig"
BR2_LINUX_KERNEL_XZ=y
BR2_LINUX_KERNEL_INSTALL_TARGET=y
BR2_LINUX_KERNEL_NEEDS_HOST_LIBELF=y
BR2_PACKAGE_BUSYBOX_CONFIG="${BR2_EXTERNAL_NERVES_PATH}/board/nerves-common/busybox.config"
BR2_PACKAGE_E2FSPROGS=y
# BR2_PACKAGE_E2FSPROGS_FSCK is not set
BR2_PACKAGE_CA_CERTIFICATES=y
BR2_PACKAGE_LIBP11=y
BR2_PACKAGE_UNIXODBC=y
BR2_PACKAGE_LIBMNL=y
BR2_PACKAGE_LIBNL=y
# BR2_TARGET_ROOTFS_TAR is not set
# No bootloader: the kernel is built with CONFIG_EFI_STUB=y and booted directly
# by UEFI firmware from the ESP at /EFI/BOOT/BOOTX64.EFI. See PLAN.md.
BR2_PACKAGE_HOST_DOSFSTOOLS=y
# kexec-tools for the Phase 2 kexec-based A/B update/validate/commit flow.
BR2_PACKAGE_KEXEC=y
# Cold-boot A/B selector installed at /EFI/BOOT/BOOTX64.EFI (selects gnu-efi).
BR2_PACKAGE_UEFI_AB_CHOOSER=y
BR2_NERVES_SYSTEM_NAME="nerves_system_x86_64_uefi"
BR2_NERVES_ADDITIONAL_IMAGE_FILES="${NERVES_DEFCONFIG_DIR}/fwup.conf"
BR2_PACKAGE_NBTTY=y
BR2_PACKAGE_NERVES_CONFIG=y
BR2_PACKAGE_NERVES_CONFIG_ACCEPT_RNG_NOTICE=y
```

## package/uefi-ab-chooser/Config.in
```kconfig
config BR2_PACKAGE_UEFI_AB_CHOOSER
	bool "uefi-ab-chooser"
	depends on BR2_x86_64
	select BR2_PACKAGE_GNU_EFI
	help
	  Minimal, read-only UEFI A/B boot selector for this system.

	  Installed on the ESP at /EFI/BOOT/BOOTX64.EFI. It reads the
	  active slot from /EFI/nerves/bootstate and starts the matching
	  per-slot kernel (/EFI/nerves/vmlinuz-{a,b}.efi), passing the
	  slot's root=PARTUUID via EFI LoadOptions.

	  https://github.com/oshlabs/uefi_ab_chooser

comment "uefi-ab-chooser needs an x86_64 target"
	depends on !BR2_x86_64
```
